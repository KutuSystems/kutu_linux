## drivers/gpu/drm/axi_kutu_hdmi/Kconfig
```kconfig
config DRM_AXI_KUTU_HDMI
	tristate "DRM Support for Kutu HDMI FPGA platforms"
	depends on DRM
	default	n
	select DRM_KMS_HELPER
	select DRM_KMS_CMA_HELPER
	select XILINX_VDMA
	select VT_HW_CONSOLE_BINDING if FRAMEBUFFER_CONSOLE
```
